## config/Kconfig/Kconfig
```kconfig
# Copyright (c) 2025 Percepio AB
# SPDX-License-Identifier: Apache-2.0

rsource "Kconfig.StartMode"
rsource "Kconfig.BufferAllocation"
rsource "Kconfig.StreamPort"
rsource "Kconfig.InternalBuffer"
rsource "Kconfig.EntryTable"
rsource "Kconfig.TraceCoverage"
rsource "Kconfig.TraceControl"
rsource "Kconfig.ISR"
rsource "Kconfig.StackMonitor"
rsource "Kconfig.TaskMonitor"
rsource "Kconfig.Debug"
```

## config/Kconfig/Kconfig.BufferAllocation
```kconfig
# Copyright (c) 2025 Percepio AB
# SPDX-License-Identifier: Apache-2.0

choice PERCEPIO_TRC_CFG_RECORDER_BUFFER_ALLOCATION
	prompt "Recorder Allocation Mode"
	default PERCEPIO_TRC_RECORDER_BUFFER_ALLOCATION_STATIC
	help
		Specifies how the recorder buffer is allocated (also in case of streaming, in
		port using the recorders internal temporary buffer)
		
		Values:
			PERCEPIO_TRC_RECORDER_BUFFER_ALLOCATION_STATIC  - Static allocation (internal)
			PERCEPIO_TRC_RECORDER_BUFFER_ALLOCATION_DYNAMIC - Malloc in xTraceEnable
			PERCEPIO_TRC_RECORDER_BUFFER_ALLOCATION_CUSTOM  - Use xTraceSetBuffer
		
		Static and dynamic mode does the allocation for you, either in compile time
		(static) or in runtime (malloc).
		The custom mode allows you to control how and where the allocation is made,
		for details see PERCEPIO_TRC_ALLOC_CUSTOM_BUFFER and xTraceSetBuffer().
	
	config PERCEPIO_TRC_RECORDER_BUFFER_ALLOCATION_STATIC
		bool "Static allocation"
	
	config PERCEPIO_TRC_RECORDER_BUFFER_ALLOCATION_DYNAMIC
		bool "Dynamic allocation"
	
	config PERCEPIO_TRC_RECORDER_BUFFER_ALLOCATION_CUSTOM
		bool "Custom allocation"
endchoice
```

## config/Kconfig/Kconfig.Debug
```kconfig
# Copyright (c) 2025 Percepio AB
# SPDX-License-Identifier: Apache-2.0

menu "Debug"
config PERCEPIO_TRC_CFG_RECORDER_DATA_INIT
  int "Data Init"
  default 1
  help
    Macro that states wether the recorder data should have an initial value.
    
    In very specific cases where traced objects are created before main(),
    the recorder will need to be started even before that. In these cases,
    the recorder data would be initialized by xTraceInitialize() but could
    then later be overwritten by the initialization value.
    If this is an issue for you, set PERCEPIO_TRC_CFG_RECORDER_DATA_INIT to 0.
    The following code can then be used before any traced objects are created:

    extern uint32_t RecorderEnabled;
    RecorderEnabled = 0;
    xTraceInitialize();

    After the clocks are properly initialized, use xTraceEnable(...) to start
    the tracing.

config PERCEPIO_TRC_CFG_USE_TRACE_ASSERT
  bool "Trace Asserts"
  default n
  help
    Enable or disable debug asserts. Information regarding any assert that is
    triggered will be in trcAssert.c.
endmenu
```

## config/Kconfig/Kconfig.EntryTable
```kconfig
# Copyright (c) 2025 Percepio AB
# SPDX-License-Identifier: Apache-2.0

menu "Entry Table"
	config PERCEPIO_TRC_CFG_ENTRY_TABLE_SLOTS
		int "Entry Table Slots"
		range 1 4194304
		default 40
		help
			The maximum number of objects and symbols that can be stored. This includes:
			- Task names
			- Named ISRs (xTraceISRRegister)
			- Named kernel objects (xTraceObjectSetNameWithoutHandle)
			- User event channels (xTraceRegisterString)
			
			If this value is too small, not all objects and symbol names will be
			stored and the trace display will be affected. In that case, there 
			will be warnings (as User Events) from TzCtrl task, which monitors this.

	config PERCEPIO_TRC_CFG_ENTRY_SYMBOL_MAX_LENGTH
		int "Symbol Max Length"
		range 1 28
		default 28
		help
			The maximum length of symbol names, including:
			- Task names
			- Named ISRs (xTraceISRRegister)
			- Named kernel objects (xTraceObjectSetNameWithoutHandleandle)
			- User event channel names (xTraceRegisterString)
			
			If longer symbol names are used, they will be truncated by the recorder,
			which will affect the trace display. In that case, there will be warnings
			(as User Events) from TzCtrl task, which monitors this.
endmenu
```

## config/Kconfig/Kconfig.ISR
```kconfig
# Copyright (c) 2025 Percepio AB
# SPDX-License-Identifier: Apache-2.0

menu "ISR"
	config PERCEPIO_TRC_CFG_MAX_ISR_NESTING
		int "Max ISR Nesting"
		range 1 1048576
		default 8
		help
		  Defines how many levels of interrupt nesting the recorder can handle, in
		  case multiple ISRs are traced and ISR nesting is possible. If this
		  is exceeded, the particular ISR will not be traced and the recorder then
		  logs an error message. This setting is used to allocate an internal stack
		  for keeping track of the previous execution context (4 byte per entry).

	config PERCEPIO_TRC_CFG_ISR_TAILCHAINING_THRESHOLD
		int "ISR Tailchaining Threshold"
		range 0 4194304
		default 0
		help
		  If tracing multiple ISRs, this setting allows for accurate display of the
		  context-switching also in cases when the ISRs execute in direct sequence.
		  
		  xTraceISREnd normally assumes that the ISR returns to the previous
		  context, i.e., a task or a preempted ISR. But if another traced ISR
		  executes in direct sequence, Tracealyzer may incorrectly display a minimal
		  fragment of the previous context in between the ISRs.
		  
		  By using PERCEPIO_TRC_CFG_ISR_TAILCHAINING_THRESHOLD you can avoid this. This is
		  however a threshold value that must be measured for your specific setup.
		  
		  The default setting is 0, meaning "disabled" and that you may get an
		  extra fragments of the previous context in between tail-chained ISRs.

	menuconfig PERCEPIO_TRC_CFG_AUTOISR
		bool "Automatic ISR tracing"
		depends on !PERCEPIO_TRC_CFG_SCHEDULING_ONLY && CPU_CORTEX_M && PERCEPIO_TRC_CFG_RECORDER_RTOS_ZEPHYR
		default n
		help
		  If this is enabled, all ISRs will be traced automatically (i.e.
		  without manual registration and without having to add 
		  xTraceISRBegin()/xTraceISREnd() manually). 
		  ISRs and their properties are taken from the devicetree.
		  
		  Note that tracing high-frequency interrupts may have a significant 
		  impact on real-time performance. If you want certain ISRs to be
		  ignored, then you use the "IRQ filter" subproperty.
		  
		  A file AutoISR-v1.1.0.xml will be created in the build directory,
		  which will be needed to load the trace.
		  
		  In case of an IRQ numbering conflict, a warning is emitted and the 
		  first device is used. The conflict can be resolved by defining an 
		  overlay and using /delete-property/ on the superfluous interrupts 
		  (and interrupt-names).
		  
		  Extra ISRs can be added in the "zephyr,user" node.

if PERCEPIO_TRC_CFG_AUTOISR
	config PERCEPIO_TRC_CFG_AUTOISR_FILTER
		bool "IRQ filter"
		default n
		help
		  Enables a user-defined function int32_t iTraceIRQFilter(int32_t) that 
		  allows to change the IRQ number passed to the trace recorder. If the 
		  returned number is negative, the ISR will not be traced.
endif # PERCEPIO_TRC_CFG_AUTOISR
endmenu # "ISR"
```

## config/Kconfig/Kconfig.InternalBuffer
```kconfig
# Copyright (c) 2025 Percepio AB
# SPDX-License-Identifier: Apache-2.0

menuconfig PERCEPIO_TRC_CFG_STREAM_PORT_USE_INTERNAL_BUFFER
	bool "Internal Buffer"
	depends on PERCEPIO_TRC_CFG_STREAM_PORT_ESP_IDF_APPTRACE || \
	PERCEPIO_TRC_CFG_STREAM_PORT_ITM || \
	PERCEPIO_TRC_CFG_STREAM_PORT_FILE || \
	PERCEPIO_TRC_CFG_STREAM_PORT_TCPIP || \
	PERCEPIO_TRC_CFG_STREAM_PORT_UDP || \
	PERCEPIO_TRC_CFG_STREAM_PORT_STM32_USB_CDC
	default n

if PERCEPIO_TRC_CFG_STREAM_PORT_USE_INTERNAL_BUFFER
	config PERCEPIO_TRC_CFG_INTERNAL_BUFFER_SIZE
		int "Internal buffer size"
		range 32 10485760
		default 10240

	choice PERCEPIO_TRC_CFG_INTERNAL_BUFFER_TRANSFER_MODE
		prompt "Internal buffer transfer mode"
		default PERCEPIO_TRC_INTERNAL_EVENT_BUFFER_OPTION_TRANSFER_MODE_ALL

		config PERCEPIO_TRC_INTERNAL_EVENT_BUFFER_OPTION_TRANSFER_MODE_ALL
			bool "Transfer all"

		config PERCEPIO_TRC_INTERNAL_EVENT_BUFFER_OPTION_TRANSFER_MODE_CHUNK
			bool "Transfer chunks"
	endchoice

	if PERCEPIO_TRC_INTERNAL_EVENT_BUFFER_OPTION_TRANSFER_MODE_CHUNK
		config PERCEPIO_TRC_CFG_INTERNAL_BUFFER_CHUNK_SIZE
			int "Chunk size"
			range 4 10485760
			default 2048

		config PERCEPIO_TRC_CFG_INTERNAL_BUFFER_CHUNK_TRANSFER_AGAIN_SIZE_LIMIT
			int "Transfer size limit for immediate re-transfer"
			range 4 10485760
			default 1024
			help
			  Defines the number of transferred bytes needed to trigger another immediate transfer.
			  This will increase throughput by immediately doing a transfer and not wait for another xTraceTzCtrl() loop.

		config PERCEPIO_TRC_CFG_INTERNAL_BUFFER_CHUNK_TRANSFER_AGAIN_COUNT_LIMIT
			int "Immediate re-transfer count limit"
			range 1 20
			default 5
			help
			  Defines the maximum number of times to trigger another immediate transfer before returning to xTraceTzCtrl().
			  This will increase throughput by immediately doing a transfer and not wait for another xTraceTzCtrl() loop.
	endif # PERCEPIO_TRC_INTERNAL_EVENT_BUFFER_OPTION_TRANSFER_MODE_CHUNK
endif # PERCEPIO_TRC_CFG_STREAM_PORT_USE_INTERNAL_BUFFER
```

## config/Kconfig/Kconfig.StackMonitor
```kconfig
# Copyright (c) 2025 Percepio AB
# SPDX-License-Identifier: Apache-2.0

menuconfig PERCEPIO_TRC_CFG_ENABLE_STACK_MONITOR
	bool "Stack Monitor"
  	select TRACING_STACK if PERCEPIO_TRC_CFG_RECORDER_RTOS_ZEPHYR
	select THREAD_STACK_INFO if PERCEPIO_TRC_CFG_RECORDER_RTOS_ZEPHYR
	default n
	help 
	  If enabled (1), the recorder periodically reports the unused stack space of 
	  all active tasks. The stack monitoring runs in the Tracealyzer Control task, 
	  TzCtrl. This task is always created by the recorder when in streaming mode. 
	  In snapshot mode, the TzCtrl task is only used for stack monitoring and is 
	  not created unless this is enabled.

if PERCEPIO_TRC_CFG_ENABLE_STACK_MONITOR

config PERCEPIO_TRC_CFG_STACK_MONITOR_MAX_TASKS
	int "Stack Monitor Max Tasks"
	range 1 64
	default 15
	help
	  This controls how many tasks that can be monitored by the stack monitor.
	  If this is too small, some tasks will be excluded and a warning is shown.

config PERCEPIO_TRC_CFG_STACK_MONITOR_MAX_REPORTS
	int "Stack Monitor Max Reports"
	range 1 64
	default 1
	help
	  This defines how many tasks that will be subject to stack usage analysis for
	  each execution of the Tracealyzer Control task (TzCtrl). Note that the stack
	  monitoring cycles between the tasks, so this does not affect WHICH tasks that
	  are monitored, but HOW OFTEN each task stack is analyzed. 
	  
	  This setting can be combined with PERCEPIO_TRC_CFG_CTRL_TASK_DELAY to tune the
	  frequency of the stack monitoring. This is motivated since the stack analysis
	  can take some time to execute.
	  However, note that the stack analysis runs in a separate task (TzCtrl) that
	  can be executed on low priority. This way, you can avoid that the stack
	  analysis disturbs any time-sensitive tasks.

endif # PERCEPIO_TRC_CFG_ENABLE_STACK_MONITOR
```

## config/Kconfig/Kconfig.StartMode
```kconfig
# Copyright (c) 2025 Percepio AB
# SPDX-License-Identifier: Apache-2.0

choice PERCEPIO_TRC_CFG_START_MODE
	prompt "Recorder Start Mode"
	default PERCEPIO_TRC_START_MODE_START_FROM_HOST if PERCEPIO_TRC_STREAM_PORT_BIDIRECTIONAL
	default PERCEPIO_TRC_START_MODE_START if !PERCEPIO_TRC_STREAM_PORT_BIDIRECTIONAL
	help
      Determines when the trace recorder should start tracing.

config PERCEPIO_TRC_START_MODE_START
	bool "Start at boot"
	help
	  Starts the tracing directly at kernel startup.

config PERCEPIO_TRC_START_MODE_START_AWAIT_HOST
	bool "Await host"
	depends on PERCEPIO_TRC_STREAM_PORT_BIDIRECTIONAL
	help
      Blocks kernel startup until a Start command is received
	  (e.g. from the "Start Recording" button in Tracealyzer).

config PERCEPIO_TRC_START_MODE_START_FROM_HOST
	bool "From host"
	depends on PERCEPIO_TRC_STREAM_PORT_BIDIRECTIONAL
	help
	  Starts up without blocking. Tracing will be started when a Start command is received
	  (e.g. from the "Start Recording" button in Tracealyzer).

config PERCEPIO_TRC_START_MODE_MANUAL
	bool "Manual"
	help
	  Tracing can be started by manually calling xTraceEnable(TRC_START).

endchoice
```

## config/Kconfig/Kconfig.StreamPort
```kconfig
# Copyright (c) 2025 Percepio AB
# SPDX-License-Identifier: Apache-2.0

config PERCEPIO_TRC_STREAM_PORT_BIDIRECTIONAL
	bool
	help
		Selected when a StreamPort can receive commands from the host.

menu "StreamPort Settings"
	choice PERCEPIO_TRC_CFG_STREAM_PORT
		prompt "StreamPort"
		default PERCEPIO_TRC_CFG_STREAM_PORT_RINGBUFFER if !PERCEPIO_TRC_CFG_RECORDER_RTOS_ZEPHYR
		default PERCEPIO_TRC_CFG_STREAM_PORT_RTT if PERCEPIO_TRC_CFG_RECORDER_RTOS_ZEPHYR

		config PERCEPIO_TRC_CFG_STREAM_PORT_ESP_IDF_APPTRACE
			bool "ESP-IDF APPTRACE"
			depends on (PERCEPIO_TRC_CFG_RECORDER_RTOS_ESPIDF_FREERTOS)
			select PERCEPIO_TRC_STREAM_PORT_BIDIRECTIONAL

		config PERCEPIO_TRC_CFG_STREAM_PORT_RTT
			bool "RTT"
			depends on ((ARM || ARM64) && PERCEPIO_TRC_CFG_RECORDER_RTOS_ZEPHYR) || \
				PERCEPIO_TRC_CFG_RECORDER_RTOS_THREADX || \
				PERCEPIO_TRC_CFG_RECORDER_RTOS_FREERTOS
			select USE_SEGGER_RTT if PERCEPIO_TRC_CFG_RECORDER_RTOS_ZEPHYR
			select PERCEPIO_TRC_STREAM_PORT_BIDIRECTIONAL

		config PERCEPIO_TRC_CFG_STREAM_PORT_ITM
			bool "ITM"
			depends on ((ARM || ARM64) && PERCEPIO_TRC_CFG_RECORDER_RTOS_ZEPHYR) || \
				PERCEPIO_TRC_CFG_RECORDER_RTOS_THREADX || \
				PERCEPIO_TRC_CFG_RECORDER_RTOS_FREERTOS
			select PERCEPIO_TRC_STREAM_PORT_BIDIRECTIONAL if PERCEPIO_TRC_CFG_STREAM_PORT_ITM_INPUT

		config PERCEPIO_TRC_CFG_STREAM_PORT_RINGBUFFER
			bool "Ring Buffer"

		config PERCEPIO_TRC_CFG_STREAM_PORT_FILE
			bool "File"

		config PERCEPIO_TRC_CFG_STREAM_PORT_TCPIP
			bool "TCP/IP"
			depends on !PERCEPIO_TRC_CFG_RECORDER_RTOS_ZEPHYR
			select PERCEPIO_TRC_CFG_STREAM_PORT_USE_INTERNAL_BUFFER
			select PERCEPIO_TRC_STREAM_PORT_BIDIRECTIONAL

		config PERCEPIO_TRC_CFG_STREAM_PORT_UDP
			bool "UDP"
			depends on !PERCEPIO_TRC_CFG_RECORDER_RTOS_ZEPHYR
			select PERCEPIO_TRC_CFG_STREAM_PORT_USE_INTERNAL_BUFFER
			select PERCEPIO_TRC_STREAM_PORT_BIDIRECTIONAL

		config PERCEPIO_TRC_CFG_STREAM_PORT_STM32_USB_CDC
			bool "STM32 USB CDC"
			depends on !PERCEPIO_TRC_CFG_RECORDER_RTOS_ZEPHYR && \
				!PERCEPIO_TRC_CFG_RECORDER_RTOS_ESPIDF_FREERTOS
			select PERCEPIO_TRC_STREAM_PORT_BIDIRECTIONAL

		config PERCEPIO_TRC_CFG_STREAM_PORT_ZEPHYR_SEMIHOST
			bool "Semihost"
			depends on PERCEPIO_TRC_CFG_RECORDER_RTOS_ZEPHYR && \
				SEMIHOST
	endchoice

if PERCEPIO_TRC_CFG_STREAM_PORT_RTT
orsource "../../streamports/Jlink_RTT/Kconfig"
endif

if PERCEPIO_TRC_CFG_STREAM_PORT_ITM
orsource "../../streamports/ARM_ITM/Kconfig"
endif

if PERCEPIO_TRC_CFG_STREAM_PORT_RINGBUFFER
orsource "../../streamports/RingBuffer/Kconfig"
endif

if PERCEPIO_TRC_CFG_STREAM_PORT_FILE
orsource "../../streamports/File/Kconfig"
endif

if PERCEPIO_TRC_CFG_STREAM_PORT_ZEPHYR_SEMIHOST
orsource "../../kernelports/Zephyr/streamports/Semihost/Kconfig"
endif

if PERCEPIO_TRC_CFG_STREAM_PORT_ESP_IDF_APPTRACE
orsource "../../kernelports/ESP-IDF_FreeRTOS/streamports/ESP_IDF_APPTRACE/Kconfig"
endif

if PERCEPIO_TRC_CFG_STREAM_PORT_TCPIP
orsource "../../streamports/TCPIP/Kconfig"
endif

if PERCEPIO_TRC_CFG_STREAM_PORT_UDP
orsource "../../streamports/UDP/Kconfig"
endif

if PERCEPIO_TRC_CFG_STREAM_PORT_STM32_USB_CDC
orsource "../../streamports/STM32_USB_CDC/Kconfig"
endif

endmenu # "StreamPort Selection"
```
