## Kconfig
```kconfig
# Copyright (c) 2021 Percepio AB
# SPDX-License-Identifier: Apache-2.0

menu "Trace Recorder"
choice PERCEPIO_TRC_CFG_RECORDER_RTOS
	prompt "Recorder RTOS"
  	default PERCEPIO_TRC_CFG_RECORDER_RTOS_FREERTOS

config PERCEPIO_TRC_CFG_RECORDER_RTOS_FREERTOS
	bool "FreeRTOS"
	
config PERCEPIO_TRC_CFG_RECORDER_RTOS_THREADX
	bool "ThreadX"
	
config PERCEPIO_TRC_CFG_RECORDER_RTOS_ZEPHYR
	bool "Zephyr"
endchoice

if PERCEPIO_TRC_CFG_RECORDER_RTOS_FREERTOS
rsource "kernelports/FreeRTOS/config/Kconfig"
endif # PERCEPIO_TRC_CFG_RECORDER_RTOS_FREERTOS

if PERCEPIO_TRC_CFG_RECORDER_RTOS_THREADX
rsource "kernelports/ThreadX/config/Kconfig"
endif # PERCEPIO_TRC_CFG_RECORDER_RTOS_THREADX

if PERCEPIO_TRC_CFG_RECORDER_RTOS_ZEPHYR
rsource "kernelports/Zephyr/config/Kconfig"
endif # PERCEPIO_TRC_CFG_RECORDER_RTOS_ZEPHYR
endmenu # "Trace Recorder"
```
