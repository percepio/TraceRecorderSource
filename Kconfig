## config/Kconfig/Kconfig.TaskMonitor
```kconfig
# Copyright (c) 2025 Percepio AB
# SPDX-License-Identifier: Apache-2.0

menuconfig PERCEPIO_TRC_CFG_ENABLE_TASK_MONITOR
	bool "Task Monitor"
  	depends on !PERCEPIO_TRC_CFG_RECORDER_RTOS_ZEPHYR || THREAD_LOCAL_STORAGE
	default n
	help 
	  If enabled (1), the recorder will keep track of clock cycles used by all tasks
	  that are registered using xTraceTaskMonitorRegister().
	  Note that xTraceTaskMonitorRegister() must be called from within each task in
	  order to access ThreadLocalStorage.
	  Periodically call on xTraceTaskMonitorPoll() from a user function to verify
	  that no tasks has used an unacceptable percentage of clock cycles since last
	  time. If that would happen a callback is used to inform the application of it.
	  The callback is set using xTraceTaskMonitorSetCallback().

if PERCEPIO_TRC_CFG_ENABLE_TASK_MONITOR

config PERCEPIO_TRC_CFG_TASK_MONITOR_MAX_TASKS
	int "Task Monitor Max Tasks"
	range 1 64
	default 10
	help
	  This controls how many tasks that can be monitored by the task monitor.
	  If this is too small, some tasks may not be registered properly.

endif # PERCEPIO_TRC_CFG_ENABLE_TASK_MONITOR
```

## config/Kconfig/Kconfig.TraceControl
```kconfig
# Copyright (c) 2025 Percepio AB
# SPDX-License-Identifier: Apache-2.0

menu "Trace Control Task"
	config PERCEPIO_TRC_CFG_CTRL_TASK_PRIORITY
		int "Control Task Priority"
		range 0 32 if PERCEPIO_TRC_CFG_RECORDER_RTOS_FREERTOS || PERCEPIO_TRC_CFG_RECORDER_RTOS_ESPIDF_FREERTOS || PERCEPIO_TRC_CFG_RECORDER_RTOS_THREADX
		range -32 32 if PERCEPIO_TRC_CFG_RECORDER_RTOS_ZEPHYR
		default 4
		help
		  TzCtrl is used to receive start/stop commands from Tracealyzer and in some
		  cases also to transmit the trace data (for stream ports that use the
		  internal buffer, like TCP/IP). For such stream ports, make sure the TzCtrl
		  priority is high enough to ensure reliable periodic execution and transfer
		  of the data, but low enough to avoid disturbing any time-sensitive functions.

	config PERCEPIO_TRC_CFG_CTRL_TASK_DELAY
		int "Control Task Delay"
		range 1 1000000000
		default 10
		help
		  The delay between loops of the TzCtrl task (see PERCEPIO_TRC_CFG_CTRL_TASK_PRIORITY), 
		  which affects the frequency of the stack monitoring.
		  
		  This also affects the trace data transfer if you are using a stream port
		  leveraging the internal buffer (like TCP/IP). A shorter delay increases
		  the CPU load of TzCtrl somewhat, but may improve the performance of the
		  trace streaming, especially if the trace buffer is small.
		
	config PERCEPIO_TRC_CFG_CTRL_TASK_STACK_SIZE
		int "Control Task Stack Size"
		range 1 1048576
		default 256
		help
		  The stack size of the Tracealyzer Control (TzCtrl) task.
		  See PERCEPIO_TRC_CFG_CTRL_TASK_PRIORITY for further information about TzCtrl.
endmenu
```

## config/Kconfig/Kconfig.TraceCoverage
```kconfig
# Copyright (c) 2025 Percepio AB
# SPDX-License-Identifier: Apache-2.0

menu "Trace Coverage"
	depends on !PERCEPIO_TRC_CFG_RECORDER_RTOS_ZEPHYR
	
	config PERCEPIO_TRC_CFG_SCHEDULING_ONLY
		bool "Only Record Scheduling Events"
		default n
		help
			If this setting is enabled, only scheduling events are recorded. If disabled,
			all events are recorded (unless filtered in other ways).

	config PERCEPIO_TRC_CFG_INCLUDE_MEMMANG_EVENTS
		bool "Trace Memory Management Events"
		depends on !PERCEPIO_TRC_CFG_SCHEDULING_ONLY
		default y
		help
		  This controls if malloc and free calls should be traced. Disable this to exclude
		  malloc/free calls, or enable it to include such events in the trace.

	config PERCEPIO_TRC_CFG_INCLUDE_USER_EVENTS
		bool "Trace User Events"
		depends on !PERCEPIO_TRC_CFG_SCHEDULING_ONLY
		default y
		help
		  If this is disabled, all code related to User Events is excluded in order 
		  to reduce code size. Any attempts to store User Events are then silently
		  ignored.
		  
		  User Events are application-generated events, like "printf" but for the 
		  trace log, generated using xTracePrint and xTracePrintF.
		  The formatting is done on host-side, by Tracealyzer. User Events are 
		  therefore much faster than a console printf and can often be used
		  in timing critical code without problems.
			
		  Note: In streaming mode, User Events are used to provide error messages
		  and warnings from the recorder (in case of incorrect configuration) for
		  display in Tracealyzer. Disabling user events will also disable these
		  warnings. You can however still catch them by calling xTraceGetLastError 
		  or by putting breakpoints in prvTraceError and prvTraceWarning.

	config PERCEPIO_TRC_CFG_INCLUDE_ISR_TRACING
		bool "Trace ISR Events"
		depends on !PERCEPIO_TRC_CFG_SCHEDULING_ONLY
		default y
		help
		  If this is disabled, the code for recording Interrupt Service Routines is
		  excluded, in order to reduce code size. This means that any calls to
		  xTraceISRBegin/xTraceISREnd will be ignored.
		  This does not completely disable ISR tracing, in cases where an ISR is
		  calling a traced kernel service. These events will still be recorded and
		  show up in anonymous ISR instances in Tracealyzer, with names such as
		  "ISR sending to <queue name>".

	config PERCEPIO_TRC_CFG_INCLUDE_READY_EVENTS
		bool "Trace Task Ready Events"
		default y
		help
		  If enabled, events are recorded when tasks enter scheduling state "ready".
		  This allows Tracealyzer to show the initial pending time before tasks enter
		  the execution state, and present accurate response times.
		  If disabled, "ready events" are not created, which allows for recording
		  longer traces in the same amount of RAM.

	config PERCEPIO_TRC_CFG_INCLUDE_OSTICK_EVENTS
		bool "Trace OS Tick Events"
		depends on !PERCEPIO_TRC_CFG_SCHEDULING_ONLY
		default y
		help
		  If this is enabled, events will be generated whenever the OS clock is
		  increased. If disabled, OS tick events are not generated, which allows for
		  recording longer traces in the same amount of RAM.
	
	config PERCEPIO_TRC_CFG_INCLUDE_EVENT_GROUP_EVENTS
		bool "Trace Event Group Events"
		depends on PERCEPIO_TRC_CFG_RECORDER_RTOS_FREERTOS || PERCEPIO_TRC_CFG_RECORDER_RTOS_ESPIDF_FREERTOS
		default n
		help
			If this is disabled, the trace will exclude any "event group" events.
		
	config PERCEPIO_TRC_CFG_INCLUDE_TIMER_EVENTS
		bool "Trace Timer Events"
		depends on PERCEPIO_TRC_CFG_RECORDER_RTOS_FREERTOS || PERCEPIO_TRC_CFG_RECORDER_RTOS_ESPIDF_FREERTOS
		default n
		help
			If this is disabled, the trace will exclude any Timer events.

	config PERCEPIO_TRC_CFG_INCLUDE_PEND_FUNC_CALL_EVENTS
		bool "Trace Pend Function Events"
		depends on PERCEPIO_TRC_CFG_RECORDER_RTOS_FREERTOS || PERCEPIO_TRC_CFG_RECORDER_RTOS_ESPIDF_FREERTOS
		default n
		help
			If this is disabled, the trace will exclude any "pending function call"
			events, such as xTimerPendFunctionCall().
		
	config PERCEPIO_TRC_CFG_INCLUDE_STREAM_BUFFER_EVENTS
		bool "Trace Stream Buffer Events"
		depends on PERCEPIO_TRC_CFG_RECORDER_RTOS_FREERTOS || PERCEPIO_TRC_CFG_RECORDER_RTOS_ESPIDF_FREERTOS
		default n
		help
			If this is disabled, the trace will exclude any stream buffer or message
			buffer events.
endmenu
```

## examples/ESP-IDF/tracing/sdkconfig.defaults
```kconfig
# Enable application tracing by default
CONFIG_APPTRACE_DEST_JTAG=y
CONFIG_APPTRACE_ENABLE=y

# Enable Percepio TraceRecorder
CONFIG_PERCEPIO_RECORDER_TRC_RECORDER_MODE_STREAMING=y
CONFIG_PERCEPIO_TRACERECORDER_ENABLED=y
CONFIG_PERCEPIO_RECORDER_CFG_START_MODE_START_FROM_HOST=y
# CONFIG_PERCEPIO_RECORDER_CFG_START_MODE_START is not set
# CONFIG_PERCEPIO_RECORDER_CFG_START_MODE_START_AWAIT_HOST is not set
CONFIG_PERCEPIO_TRC_CFG_STREAM_PORT_ESP_IDF_APPTRACE=y
# CONFIG_PERCEPIO_TRC_CFG_STREAM_PORT_RINGBUFFER is not set
# CONFIG_PERCEPIO_RECORDER_CFG_TRAX_MODE_BLOCK_IF_FIFO_FULL is not set
CONFIG_PERCEPIO_RECORDER_CFG_TRAX_MODE_NO_BLOCK_SKIP=y
# CONFIG_PERCEPIO_RECORDER_CFG_SCHEDULING_ONLY is not set
CONFIG_PERCEPIO_RECORDER_CFG_INCLUDE_MEMMANG_EVENTS=y
CONFIG_PERCEPIO_RECORDER_CFG_INCLUDE_USER_EVENTS=y
CONFIG_PERCEPIO_RECORDER_CFG_INCLUDE_ISR_TRACING=y
CONFIG_PERCEPIO_RECORDER_CFG_INCLUDE_READY_EVENTS=y
CONFIG_PERCEPIO_RECORDER_CFG_INCLUDE_OSTICK_EVENTS=y
CONFIG_PERCEPIO_RECORDER_CFG_INCLUDE_EVENT_GROUP_EVENTS=y
CONFIG_PERCEPIO_RECORDER_CFG_INCLUDE_TIMER_EVENTS=y
CONFIG_PERCEPIO_RECORDER_CFG_INCLUDE_PEND_FUNC_CALL_EVENTS=y
CONFIG_PERCEPIO_RECORDER_CFG_INCLUDE_STREAM_BUFFER_EVENTS=y
CONFIG_PERCEPIO_RECORDER_CFG_ENABLE_STACK_MONITOR=y
CONFIG_PERCEPIO_RECORDER_CFG_STACK_MONITOR_MAX_TASKS=15
CONFIG_PERCEPIO_RECORDER_CFG_STACK_MONITOR_MAX_REPORTS=1
CONFIG_PERCEPIO_RECORDER_CFG_CTRL_TASK_PRIORITY=1
CONFIG_PERCEPIO_RECORDER_CFG_CTRL_TASK_DELAY=10
CONFIG_PERCEPIO_RECORDER_CFG_CTRL_TASK_STACK_SIZE=1024
CONFIG_PERCEPIO_RECORDER_TRC_RECORDER_BUFFER_ALLOCATION_STATIC=y
# CONFIG_PERCEPIO_RECORDER_TRC_RECORDER_BUFFER_ALLOCATION_DYNAMIC is not set
# CONFIG_PERCEPIO_RECORDER_TRC_RECORDER_BUFFER_ALLOCATION_CUSTOM is not set
CONFIG_PERCEPIO_RECORDER_CFG_MAX_ISR_NESTING=8
CONFIG_PERCEPIO_RECORDER_TRC_CFG_ENTRY_TABLE_SLOTS=40
CONFIG_PERCEPIO_RECORDER_TRC_CFG_ENTRY_SYMBOL_MAX_LENGTH=25
# CONFIG_PERCEPIO_RECORDER_TRC_STREAM_PORT_USE_INTERNAL_BUFFER is not set
CONFIG_PERCEPIO_RECORDER_TRC_CFG_ISR_TAILCHAINING_THRESHOLD_STREAMING=0
```

## kernelports/BareMetal/config/Kconfig
```kconfig
# Copyright (c) 2021 Percepio AB
# SPDX-License-Identifier: Apache-2.0

config PERCEPIO_RTOS
	bool
	default y
	select PERCEPIO_TRC_CFG_RECORDER_RTOS_BAREMETAL

menu "Recorder Common"
# FreeRTOS supports classic snapshot and streaming
choice PERCEPIO_TRC_CFG_RECORDER_MODE
    prompt "Tracing Mode"
    default PERCEPIO_TRC_RECORDER_MODE_STREAMING
    help
      BareMetal only suppots streaming mode.

config PERCEPIO_TRC_RECORDER_MODE_STREAMING
	bool "Streaming recorder mode"
endchoice

rsource "../../../config/Kconfig"
endmenu # "Recorder Common"

menu "Recorder BareMetal"
choice PERCEPIO_TRC_CFG_HARDWARE_PORT
    prompt "Hardware Port"
    default PERCEPIO_TRC_HARDWARE_PORT_ARM_Cortex_M

config PERCEPIO_TRC_HARDWARE_PORT_Win32
	bool "Win32"

config PERCEPIO_TRC_HARDWARE_PORT_Atmel_AT91SAM7
	bool "Atmel AT91SAM7"

config PERCEPIO_TRC_HARDWARE_PORT_Atmel_UC3A0
	bool "Atmel UC3A0"

config PERCEPIO_TRC_HARDWARE_PORT_ARM_Cortex_M
	bool "Cortex M"

config PERCEPIO_TRC_HARDWARE_PORT_ARM_CORTEX_A9
	bool "Cortex A9"

config PERCEPIO_TRC_HARDWARE_PORT_Renesas_RX600
	bool "Renesas RX600"

config PERCEPIO_TRC_HARDWARE_PORT_MICROCHIP_PIC24_PIC32
	bool "Microchip PIC24/PIC32"

config PERCEPIO_TRC_HARDWARE_PORT_TEXAS_INSTRUMENTS_TMS570_RM48
	bool "TI TMS570 RM48"

config PERCEPIO_TRC_HARDWARE_PORT_TEXAS_INSTRUMENTS_MSP430
	bool "TI MSP430"

config PERCEPIO_TRC_HARDWARE_PORT_XILINX_PPC405
	bool "Xilinx PPC405"

config PERCEPIO_TRC_HARDWARE_PORT_XILINX_PPC440
	bool "Xilinx PPC440"

config PERCEPIO_TRC_HARDWARE_PORT_XILINX_MICROBLAZE
	bool "Xilinx Microblaze"

config PERCEPIO_TRC_HARDWARE_PORT_XILINX_ZyncUltraScaleR5
	bool "Xilinx Zync Ultra Scale R5"

config PERCEPIO_TRC_HARDWARE_PORT_NXP_LPC210X
	bool "NXP LPC210X"

config PERCEPIO_TRC_HARDWARE_PORT_Altera_NiosII
	bool "Altera Nios II"
endchoice

if PERCEPIO_TRC_RECORDER_MODE_STREAMING
endif # PERCEPIO_TRC_RECORDER_MODE_STREAMING
endmenu # "Recorder BareMetal"
```

## kernelports/ESP-IDF_FreeRTOS/Kconfig.projbuild
```kconfig
# Copyright (c) 2025 Percepio AB
# SPDX-License-Identifier: Apache-2.0

menu ""
	# Empty name to avoid the menu item showing up in menuconfig even though it is set to "visible if n" (the config will be hidden, but the menu will still show up if it has a name)
	visible if n

	config PERCEPIO_TRC_CFG_RECORDER_RTOS_ESPIDF_FREERTOS
		bool "ESPIDF FreeRTOS Trace Recorder"
		default y
endmenu

menu "Percepio TraceRecorder"
	config PERCEPIO_TRACERECORDER_ENABLED
		bool "Enable Percepio TraceRecorder"
		default n
		select FREERTOS_USE_TRACE_FACILITY
		help
			Enables support for Percepio Tracealyzer tracing functionality.

if PERCEPIO_TRACERECORDER_ENABLED
# Source recorder common config
rsource "../../config/Kconfig/Kconfig"
endif # PERCEPIO_TRACERECORDER_ENABLED
endmenu
```

## kernelports/ESP-IDF_FreeRTOS/streamports/ESP_IDF_APPTRACE/Kconfig
```kconfig
# Copyright (c) 2025 Percepio AB
# SPDX-License-Identifier: Apache-2.0

choice PERCEPIO_TRC_CFG_TRAX_BLOCKING_MODE
	prompt "Stream Blocking Mode"
	depends on PERCEPIO_TRACERECORDER_ENABLED
	default PERCEPIO_TRC_CFG_TRAX_MODE_NO_BLOCK_SKIP
	help
		This stream port for streaming over XTensa Trax relies on apptrace that utilize
		an internal TRAX RAM buffer read by OpenOCD during execution.
		
		Possible values:
		- APPTRACE_TRAX_MODE_BLOCK_IF_FIFO_FULL
		- APPTRACE_TRAX_MODE_NO_BLOCK_SKIP (default)
		
		Using APPTRACE_TRAX_MODE_BLOCK_IF_FIFO_FULL ensure that you get a
		complete and valid trace. This may however cause blocking if your streaming
		interface isn't fast enough, which may disturb the real-time behavior.
		
		We therefore recommend APPTRACE_TRAX_MODE_NO_BLOCK_SKIP. In this mode,
		Tracealyzer will report lost events if the transfer is not
		fast enough. If there are problems, try increasing the apptrace buffer
		in sdkconfig.

	config PERCEPIO_TRC_CFG_TRAX_MODE_BLOCK_IF_FIFO_FULL
		bool "Block if FIFO full"

	config PERCEPIO_TRC_CFG_TRAX_MODE_NO_BLOCK_SKIP
		bool "Skip if FIFO full"
endchoice
```
