## streamports/TCPIP/Kconfig
```kconfig
# Copyright (c) 2025 Percepio AB
# SPDX-License-Identifier: Apache-2.0

config PERCEPIO_TRC_CFG_STREAM_PORT_TCPIP_PORT
	int "TCP Port"
	default 18419
	help
		This sets the TCP port used for trace data transfer.
```

## streamports/UDP/Kconfig
```kconfig
# Copyright (c) 2025 Percepio AB
# SPDX-License-Identifier: Apache-2.0

config PERCEPIO_TRC_CFG_STREAM_PORT_UDP_IP
	string "Host IP address"
	default "192.168.0.100"
	help
		This sets the IP where the trace data will be sent.

config PERCEPIO_TRC_CFG_STREAM_PORT_UDP_PORT
	int "Host UDP port"
	default 18419
	help
		This sets the UDP port where the trace data will be sent.
```
